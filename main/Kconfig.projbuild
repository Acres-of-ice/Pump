## main/Kconfig.projbuild
```kconfig
menu "Pump Controller Configuration"

    choice INTERNET_MODE
        prompt "Internet Connection Mode"
        default INTERNET_SIM
        help
            Select the primary network connectivity method.

        config INTERNET_WIFI
            bool "WiFi"
            help
                Use WiFi for network connectivity.

        config INTERNET_SIM
            bool "SIM/Cellular (4G LTE)"
            help
                Use SIM7600 cellular modem for network connectivity.
    endchoice

    menu "WiFi Configuration"
        depends on INTERNET_WIFI

        config WIFI_SSID
            string "WiFi SSID"
            default "YourSSID"
            help
                SSID (network name) to connect to.

        config WIFI_PASSWORD
            string "WiFi Password"
            default "YourPassword"
            help
                WiFi password (WPA or WPA2) to connect to.

    endmenu

    config DEVICE_ID
        string "Device ID"
        default "Shey"
        help
            Unique identifier for this device.
            Used in MQTT topics: mg_mqtt_dashboard/{DEVICE_ID}/rx

choice PUMP_TYPE
    prompt "Pump Type"
    default PUMP_BOREWELL
    help
        Select the type of pump depending on the site.

    config PUMP_BOREWELL
        bool "Borewell"
        
    config PUMP_1HP
        bool "1 HP"
endchoice

    config MQTT_BROKER_URL
        string "MQTT Broker URL"
        default "mqtt://aoi:4201@44.194.157.172:1883"
        help
            MQTT broker URL. Examples:
            - mqtt://broker.hivemq.com:1883 (public, unsecured)
            - mqtt://user:pass@broker:1883 (with authentication)
            - mqtts://your-broker.com:8883 (TLS secured)

endmenu

menu "Camera Configuration"

    config ENABLE_CAMERA
        bool "Enable Camera Support"
        default n
        help
            Enable camera hardware and MQTT camera commands.
            Camera will subscribe to simcam/{sitename}/do for commands.
        
    choice FRAMESIZE
        depends on ENABLE_CAMERA
		bool "Camera Frame Size"
		default FRAMESIZE_QSXGA
		help
			Select picture frame size for camera captures.

		config FRAMESIZE_240X240
			bool "240x240"
		config FRAMESIZE_QVGA
			bool "320x240 (QVGA)"
		config FRAMESIZE_HVGA
			bool "480x320 (HVGA)"
		config FRAMESIZE_VGA
			bool "640x480 (VGA)"
		config FRAMESIZE_SVGA
			bool "800x600 (SVGA)"
		config FRAMESIZE_XGA
			bool "1024x768 (XGA)"
		config FRAMESIZE_HD
			bool "1280x720 (HD)"
		config FRAMESIZE_SXGA
			bool "1280x1024 (SXGA)"
		config FRAMESIZE_UXGA
			bool "1600x1200 (UXGA)"
		config FRAMESIZE_QXGA
			bool "2048x1536 (QXGA)"
		config FRAMESIZE_QSXGA
			bool "2560x1920 (QSXGA)"
		config FRAMESIZE_5MP
			bool "2592x1944 (5MP)"
	endchoice
            
    config PCB_TYPE_OCT
        depends on ENABLE_CAMERA
        bool "Use OCT (Octal SPIRAM) PCB"
        default y
        help
            Enable for OCT (Octal SPIRAM) PCB variant.
            OCT mode uses GPIO 33-37 for SPIRAM, requiring alternative camera pins.

endmenu
```

## sdkconfig.defaults.8mb
```kconfig
# Default target chip
CONFIG_IDF_TARGET="esp32s3"

# Set fixed CPU frequency to 240MHz (updated symbols for ESP-IDF 5.4)
CONFIG_ESP_DEFAULT_CPU_FREQ_MHZ=240
CONFIG_ESP_DEFAULT_CPU_FREQ_MHZ_80=n
CONFIG_ESP_DEFAULT_CPU_FREQ_MHZ_240=y
CONFIG_ESP_DEFAULT_CPU_FREQ_MHZ_160=n

# PPP Internet support
CONFIG_ESP_NETIF_TCPIP_LWIP=y
CONFIG_LWIP_PPP_SUPPORT=y
CONFIG_LWIP_PPP_PAP_SUPPORT=y
CONFIG_LWIP_PPP_CHAP_SUPPORT=y

# Socket configuration
CONFIG_LWIP_MAX_SOCKETS=16
CONFIG_LWIP_SO_REUSE=y
CONFIG_LWIP_SO_RCVBUF=y

# MQTT specific TCP settings
CONFIG_LWIP_TCP_MSS=1460
CONFIG_LWIP_TCPIP_RECVMBOX_SIZE=32

# Memory management (removed deprecated symbols)
CONFIG_LWIP_TCPIP_TASK_STACK_SIZE=4096

# Use system time for log timestamps instead of RTOS ticks
CONFIG_LOG_COLORS=y
CONFIG_LOG_TIMESTAMP_SOURCE_SYSTEM=y
CONFIG_LOG_TIMESTAMP_SOURCE_RTOS=n

## MQTT Configuration
CONFIG_MQTT_PROTOCOL_311=y
CONFIG_MQTT_TRANSPORT_SSL=n
CONFIG_MQTT_TRANSPORT_WEBSOCKET=n
CONFIG_MQTT_TRANSPORT_WEBSOCKET_SECURE=n
CONFIG_MQTT_BROKER_URL="mqtt://aoi:4201@44.194.157.172:1883"

# TCP Buffer sizes
CONFIG_LWIP_TCP_SND_BUF_DEFAULT=8192
CONFIG_LWIP_TCP_WND_DEFAULT=8192

#
# Stack Overflow Protection (updated symbols for ESP-IDF 5.4)
#
CONFIG_FREERTOS_CHECK_STACKOVERFLOW_PTRVAL=y
CONFIG_FREERTOS_CHECK_STACKOVERFLOW_CANARY=n
CONFIG_FREERTOS_WATCHPOINT_END_OF_STACK=y
CONFIG_FREERTOS_USE_TRACE_FACILITY=y
CONFIG_FREERTOS_GENERATE_RUN_TIME_STATS=y

#
# Heap Optimization (disable debug features in production)
#
CONFIG_HEAP_POISONING_DISABLED=y
CONFIG_HEAP_POISONING_COMPREHENSIVE=n
CONFIG_HEAP_TRACING_OFF=y
CONFIG_HEAP_TRACING=n

# Enable power management for ESP-NOW
CONFIG_PM_ENABLE=y
CONFIG_PM_SLP_IRAM_OPT=y
CONFIG_PM_RTOS_IDLE_OPT=y

#
# Compiler Optimization for Size (reduces power and code size)
#
CONFIG_COMPILER_OPTIMIZATION_SIZE=y
CONFIG_COMPILER_OPTIMIZATION_DEBUG=n
CONFIG_COMPILER_OPTIMIZATION_PERF=n

#
# Disable Unused Peripherals
#
CONFIG_ESP_COEX_ENABLED=n
CONFIG_ETH_ENABLED=n
CONFIG_SPI_FLASH_ENABLE_COUNTERS=n

# Logging Configuration
# Set default runtime log level to INFO
CONFIG_LOG_DEFAULT_LEVEL_INFO=y
CONFIG_LOG_DEFAULT_LEVEL=3

CONFIG_ESP_MAIN_TASK_STACK_SIZE=8192

# Set maximum compile-time log level to DEBUG (allows all levels)
CONFIG_LOG_MAXIMUM_LEVEL_DEBUG=y
CONFIG_LOG_MAXIMUM_LEVEL=4

# Disable "maximum equals default" to allow runtime log level changes
CONFIG_LOG_MAXIMUM_EQUALS_DEFAULT=n

# Ensure other default levels are disabled
CONFIG_LOG_DEFAULT_LEVEL_NONE=n
CONFIG_LOG_DEFAULT_LEVEL_ERROR=n
CONFIG_LOG_DEFAULT_LEVEL_WARN=n
CONFIG_LOG_DEFAULT_LEVEL_DEBUG=n
CONFIG_LOG_DEFAULT_LEVEL_VERBOSE=n
#
# Ensure other maximum levels are disabled (removed deprecated LOG_MAXIMUM_LEVEL_NONE)
CONFIG_LOG_MAXIMUM_LEVEL_ERROR=n
CONFIG_LOG_MAXIMUM_LEVEL_WARN=n
CONFIG_LOG_MAXIMUM_LEVEL_INFO=n
CONFIG_LOG_MAXIMUM_LEVEL_VERBOSE=n

# Bootloader logging
CONFIG_BOOTLOADER_LOG_LEVEL_INFO=y
CONFIG_BOOTLOADER_LOG_LEVEL=3
CONFIG_BOOTLOADER_LOG_LEVEL_NONE=n
CONFIG_BOOTLOADER_LOG_LEVEL_ERROR=n
CONFIG_BOOTLOADER_LOG_LEVEL_WARN=n
CONFIG_BOOTLOADER_LOG_LEVEL_DEBUG=n
CONFIG_BOOTLOADER_LOG_LEVEL_VERBOSE=n

#
# Serial flasher config
#
#CONFIG_ESPTOOLPY_FLASHFREQ_80M=y
CONFIG_ESPTOOLPY_FLASHSIZE_16MB=y


#
# ESP System Settings
#
CONFIG_ESP_MAIN_TASK_STACK_SIZE=8192

#
# Partition Table
#
CONFIG_PARTITION_TABLE_CUSTOM=y
CONFIG_PARTITION_TABLE_CUSTOM_FILENAME="partitions.csv"
CONFIG_PARTITION_TABLE_FILENAME="partitions.csv"

#
# SPIRAM Support (replaces deprecated CONFIG_ESP32S3_SPIRAM_SUPPORT)
#
CONFIG_SPIRAM=y

# ============================================================================
# PSRAM Configuration - UNCOMMENT THE SECTION FOR YOUR HARDWARE
# ============================================================================
# 2MB PSRAM boards: Uncomment the "2MB PSRAM" section below
# 8MB PSRAM boards: Uncomment the "8MB PSRAM" section below
# Only ONE section should be uncommented at a time
# ============================================================================

# --- 2MB PSRAM Configuration (QUAD mode @ 40MHz) ---
# Uncomment these 3 lines for 2MB PSRAM boards:
# CONFIG_SPIRAM_MODE_QUAD=y
# CONFIG_SPIRAM_TYPE_AUTO=y
# CONFIG_SPIRAM_SPEED_40M=y

# --- 8MB PSRAM Configuration (OCT mode @ 40MHz) ---
# Uncomment these 3 lines for 8MB PSRAM boards:
CONFIG_SPIRAM_MODE_OCT=y
CONFIG_SPIRAM_TYPE_AUTO=y
CONFIG_SPIRAM_SPEED_80M=y

# CONFIG_SPIRAM_MODE_QUAD=y
# CONFIG_SPIRAM_MODE_OCT=y
# CONFIG_SPIRAM_TYPE_AUTO=y
# CONFIG_SPIRAM_SPEED_20M=y
# CONFIG_SPIRAM_SPEED_40M=n
# CONFIG_SPIRAM_IGNORE_NOTFOUND=y

# # Increase watchdog timeout to handle SIM init delays
# CONFIG_ESP_TASK_WDT_TIMEOUT_S=20
#
# # Optimize cache for OCT PSRAM
# CONFIG_ESP32S3_INSTRUCTION_CACHE_32KB=y
# CONFIG_ESP32S3_DATA_CACHE_64KB=y
# CONFIG_ESP32S3_INSTRUCTION_CACHE_LINE_32B=y
# CONFIG_ESP32S3_DATA_CACHE_LINE_64B=y

#
# Camera configuration
#
#CONFIG_OV7670_SUPPORT=y
#CONFIG_OV7725_SUPPORT=y
#CONFIG_NT99141_SUPPORT=y
# CONFIG_OV2640_SUPPORT=y
#CONFIG_OV3660_SUPPORT=y
CONFIG_OV5640_SUPPORT=y
CONFIG_CAMERA_NO_AFFINITY=y
CONFIG_SCCB_HARDWARE_I2C_PORT0=y

# Camera PSRAM DMA Configuration
# DISABLED for OCT mode due to cache coherency issues causing watchdog timeouts
# Camera buffers still use PSRAM, just accessed via CPU cache instead of DMA
CONFIG_CAMERA_DMA_BUFFER_SIZE_MAX=65536
# CONFIG_CAMERA_PSRAM_DMA=y


#
# App configuration
#
CONFIG_ENABLE_SIM=y
CONFIG_ENABLE_HTTP_STREAM=y
# CONFIG_BATTERY_I2C_SDA=15
# CONFIG_BATTERY_I2C_SCL=16
CONFIG_ENABLE_ACTIVE_COMM_WINDOW=y
CONFIG_ENABLE_SLEEP_SCHEDULE=y

#
# FAT Filesystem - Enable Long Filename Support
#
CONFIG_FATFS_LFN_HEAP=y
CONFIG_FATFS_MAX_LFN=255
CONFIG_FATFS_API_ENCODING_UTF_8=y
```
